## components/mjd_huzzah32/Kconfig
```kconfig
menu "Adafruit HUZZAH32"

config MJD_HUZZAH32_REFERENCE_VOLTAGE_MV
    int "Manual Voltage Reference in mV [default 1125 for Huzzah32, 1100 for other MCU's] for mjd_huzzah32_get_battery_voltage()"
    default 1125

endmenu
```
